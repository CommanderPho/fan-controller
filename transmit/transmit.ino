// const unsigned int toggleLight[] = {392, 416, 376, 412, 388, 420, 384, 416, 384, 408, 388, 416, 388,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 424, 380};
// const unsigned int toggleFan[] = {380, 416, 388, 408, 392, 408, 392, 412, 384, 416, 388, 412, 388,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 828, 372};
// const unsigned int increaseSpeed[] = {388, 416, 388, 416, 388, 404, 384, 420, 384, 416, 384, 408, 388,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 832, 368};
// const unsigned int decreaseSpeed[] = {384, 416, 384, 408, 396, 408, 384, 416, 388, 416, 384, 408, 396,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 420, 376};


// Good working!
const unsigned int toggleLight[] = {2372, 120, 1084, 112, 40, 40, 28, 164, 412, 492, 28, 40, 40,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 380, 424};


// Repeated middle fan button press many times prob ~8:
const unsigned int setFanLevelZero[] = {364, 828, 764, 440, 360, 840, 364, 820, 768, 448, 760, 432, 368,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 428, 768}; 

const unsigned int setFanLevelOne[] = {28, 52, 28, 244, 32, 40, 40, 40, 52, 20, 40, 68, 32,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 792, 32};

const unsigned int setFanLevelTwo[] = {364, 440, 360, 432, 364, 440, 360, 432, 376, 428, 364, 436, 364,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 436, 364};

const unsigned int setFanLevelThree[] = {28, 276, 20, 52, 28, 76, 24, 176, 28, 60, 32, 32, 28,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 20, 160};


void setup() {
  Serial.begin(9600);
  pinMode(12, OUTPUT);
  digitalWrite(12, LOW);
}

void performToggleLight() {
  // turns the light on/off
  Serial.println(F("Toggling light"));

  int state = 0;
  for (int x = 0; x < sizeof(toggleLight)/sizeof(toggleLight[0]); ++x) {
    state = !state;
    digitalWrite(12, state);
    delayMicroseconds(toggleLight[x]);
  }
  digitalWrite(12, LOW);
}

void performSetFanSpeedZero() {
  Serial.println(F("Setting fan level to 0"));
  int state = 0;
  for (int x = 0; x < sizeof(setFanLevelZero)/sizeof(setFanLevelZero[0]); ++x) {
    state = !state;
    digitalWrite(12, state);
    delayMicroseconds(setFanLevelZero[x]);
  }
  digitalWrite(12, LOW);
}

void performSetFanSpeedOne() {
  Serial.println(F("Setting fan level to 1"));
  int state = 0;
  for (int x = 0; x < sizeof(setFanLevelOne)/sizeof(setFanLevelOne[0]); ++x) {
    state = !state;
    digitalWrite(12, state);
    delayMicroseconds(setFanLevelOne[x]);
  }
  digitalWrite(12, LOW);
}

void performSetFanSpeedTwo() {
  Serial.println(F("Setting fan level to 2"));
  int state = 0;
  for (int x = 0; x < sizeof(setFanLevelTwo)/sizeof(setFanLevelTwo[0]); ++x) {
    state = !state;
    digitalWrite(12, state);
    delayMicroseconds(setFanLevelTwo[x]);
  }
  digitalWrite(12, LOW);
}





// void performSetFanSpeed(int fan_level) {
//   // turns the light on/off
//   Serial.println(F("Setting fan level "));

//   int state = 0;
//   for (int x = 0; x < sizeof(setFanLevelZero)/sizeof(setFanLevelZero[0]); ++x) {
//     state = !state;
//     digitalWrite(12, state);
//     delayMicroseconds(setFanLevelZero[x]);
//   }
//   digitalWrite(12, LOW);
// }



void loop() {
  Serial.println("Starting Send...");
  performSetFanSpeedZero();
  // performSetFanSpeedOne();
  // performSetFanSpeedTwo();
  performToggleLight();

  
  Serial.println("Reset your Arduino to transmit again...");

  while(true) {}
}
